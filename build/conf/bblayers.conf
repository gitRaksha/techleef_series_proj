## build/conf/bblayers.conf
```bitbake
# POKY_BBLAYERS_CONF_VERSION is increased each time build/conf/bblayers.conf
# changes incompatibly
POKY_BBLAYERS_CONF_VERSION = "2"

BBPATH = "${TOPDIR}"
BBFILES ?= ""

BBLAYERS ?= " \
  /home/marwen/techleef_series_proj/layers/poky/meta \
  /home/marwen/techleef_series_proj/layers/poky/meta-poky \
  /home/marwen/techleef_series_proj/layers/poky/meta-yocto-bsp \
  /home/marwen/techleef_series_proj/layers/meta-techleef \
  "
```
